## config/boards/arm/tkl_ffc_w2/Kconfig.board
```kconfig
# Copyright (c) 2020 The ZMK Contributors
# SPDX-License-Identifier: MIT

config BOARD_TKL_FFC_W2
	bool "TKL-FFC-W2"
	depends on SOC_NRF52840_QIAA
```
